#include "Cal_Freq.h"

unsigned short index;                      // 输入信号的频率对应的索引值
unsigned short harmo3_index, harmo5_index; // 输入信号三次和五次谐波频率对应的索引值
float temp_float;
float mag_1harmo[2], mag_3harmo[2]; // 一次和三次谐波上的能量及其比值
float k[2] = {0}; // 比值
float mag_5harmo;                // 五次谐波上的能量
int threshold[2]={0};//动态阈值，低频时受噪声干扰大

int mag[512],sum = 0, average;

//test
// unsigned short index;                      // 输入信号的频率对应的索引值
// unsigned short harmo3_index, harmo5_index; // 输入信号三次和五次谐波频率对应的索引值
// float temp_float;
// float mag_1harmo, mag_3harmo, k; // 一次和三次谐波上的能量及其比值
// float mag_5harmo;                // 五次谐波上的能量


// 信号频率
unsigned char fre[2];// fre[0] = 0; --- 10KHz, fre[1] = 1; --- 15KHz
// 信号种类
unsigned char wave_type[2];// 0 --- 正/余弦，1 --- 三角形方波
// ADC采样值存储
short adc_complex_value[1000];

double pos_angle_0; // 转换为延迟0-2pi，全部为整数的角度，重建信号延迟的相位
double pos_angle_1; // 转换为延迟0-2pi，全部为整数的角度，重建信号延迟的相位

// 标准频率sin与cos表 ---  10KHz ~ 100KHz (5KHz步进)
//========== DAC_SIN 数组 ==========
short DAC_SIN[200 * 19] =
{
    2087, 2126, 2164, 2202, 2240, 2276, 2312, 2347, 2380, 2412, 2443, 2472,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 2048,
    2106, 2164, 2221, 2276, 2329, 2380, 2428, 2472, 2513, 2550, 2582, 2609,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 2048,
    2126, 2202, 2276, 2347, 2412, 2472, 2526, 2571, 2609, 2638, 2657, 2667,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 2048,
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    2412, 2638, 2638, 2412, 2048, 1684, 1458, 1458, 1684, 2048, 2412, 2638,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 2048
};

//========== DAC_COS 数组 ==========
short DAC_COS[200 * 19] =
{
    2667, 2663, 2657, 2649, 2638, 2624, 2609, 2591, 2571, 2550, 2526, 2500,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 2668,
    2665, 2657, 2643, 2624, 2600, 2571, 2538, 2500, 2458, 2412, 2364, 2312,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 2668,
    2663, 2649, 2624, 2591, 2550, 2500, 2443, 2380, 2312, 2240, 2164, 2087,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 2668,
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    2550, 2240, 1856, 1546, 1428, 1546, 1856, 2240, 2550, 2668, 2550, 2240,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 2668
};

//========== Tri_Wave 数组 ==========
// short Tri_Wave[200 * 19] =
// {
//     1453, 1478, 1502, 1527, 1552, 1577, 1602, 1626, 1651, 1676, 1701, 1726, 1750,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 1428,
//     1465, 1502, 1540, 1577, 1614, 1651, 1688, 1726, 1763, 1800, 1837, 1874, 1912,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 1428,
//     1478, 1527, 1577, 1626, 1676, 1726, 1775, 1825, 1874, 1924, 1974, 2023, 2073,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 1428,
//     1490, 1552, 1614, 1676, 1738, 1800, 1862, 1924, 1986, 2048, 2110, 2172, 2234,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 1428,
//     1502, 1577, 1651, 1726, 1800, 1874, 1949, 2023, 2098, 2172, 2246, 2321, 2395,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 1428,
//     1515, 1602, 1688, 1775, 1862, 1949, 2036, 2122, 2209, 2296, 2383, 2470, 2556,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 1428,
//     1527, 1626, 1726, 1825, 1924, 2023, 2122, 2222, 2321, 2420, 2519, 2618, 2618,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 1428,
//     1540, 1651, 1763, 1874, 1986, 2098, 2209, 2321, 2432, 2544, 2656, 2569, 2457,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 1428,
//     1552, 1676, 1800, 1924, 2048, 2172, 2296, 2420, 2544, 2668, 2544, 2420, 2296,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 1428,
//     1564, 1701, 1837, 1974, 2110, 2246, 2383, 2519, 2656, 2544, 2408, 2271, 2135,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 1428,
//     1577, 1726, 1874, 2023, 2172, 2321, 2470, 2618, 2569, 2420, 2271, 2122, 1974,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 1428,
//     1589, 1750, 1912, 2073, 2234, 2395, 2556, 2618, 2457, 2296, 2135, 1974, 1812,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 1428,
//     1602, 1775, 1949, 2122, 2296, 2470, 2643, 2519, 2346, 2172, 1998, 1825, 1651,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 1428,
//     1614, 1800, 1986, 2172, 2358, 2544, 2606, 2420, 2234, 2048, 1862, 1676, 1490,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 1428,
//     1626, 1825, 2023, 2222, 2420, 2618, 2519, 2321, 2122, 1924, 1726, 1527, 1527,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 1428,
//     1639, 1850, 2060, 2271, 2482, 2643, 2432, 2222, 2011, 1800, 1589, 1478, 1688,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 1428,
//     1651, 1874, 2098, 2321, 2544, 2569, 2346, 2122, 1899, 1676, 1453, 1626, 1850,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 1428,
//     1664, 1899, 2135, 2370, 2606, 2494, 2259, 2023, 1788, 1552, 1540, 1775, 2011,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 1428,
//     1676, 1924, 2172, 2420, 2668, 2420, 2172, 1924, 1676, 1428, 1676, 1924, 2172,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 1428
// };
short Tri_Wave[200 * 19] =
{
    1972, 1944, 1916, 1888, 1860, 1832, 1804, 1776, 1748, 1720, 1692, 1664,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 2000,
    1958, 1916, 1874, 1832, 1790, 1748, 1706, 1664, 1622, 1580, 1538, 1496,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 2000,
    1944, 1888, 1832, 1776, 1720, 1664, 1608, 1552, 1496, 1440, 1384, 1328,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 2000,
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    1720, 1440, 1440, 1720, 2000, 2280, 2560, 2560, 2280, 2000, 1720, 1440,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 2000
};


// 确定频率用
/*
    @param    data 采样的电压值
    @mask     sin/cos
    1、DC偏置有误差影响不大，mask为周期函数，平均值为0
*/
double corr1000_200(short *data, short *mask)
{
    double res = 0;
    short i;
    //累加
    for (i = 0; i < 1000; i++)
        res = res + (data[i] - 2048) * (mask[i % 200] - 2048); //注意SIN与COS模版要减去直流偏置，才是真正的信号

    return res;
}

// 计算IQ分量的模的长度，频点的功率
double modulus(double I, double Q)
{
    double temp_double;
    temp_double = sqrt(I * I + Q * Q);
    return temp_double;
}

// 计算参与叠加的两个正弦信号的频率
void Cal_Freq(unsigned char *frq) 
{
    //频率计算参数
    double mag_d[19];         // 用于存放输入信号与所有19种信号相关计算的模
    double temp_double[19];
    double corr_sin_double; // 用于存放C与所有19种正弦相关计算的结果
    double corr_cos_double; // 用于存放C与所有19种余弦相关计算的结果
    double sort_temp;
    unsigned char i, j, temp_char;
    for (i = 0; i < 19; i++)
    {
        corr_sin_double = corr1000_200(adc_complex_value, DAC_SIN + 200 * i);
        corr_cos_double = corr1000_200(adc_complex_value, DAC_COS + 200 * i);
        
        mag_d[i] = modulus(corr_sin_double, corr_cos_double);
        temp_double[i] = mag_d[i];
    }

    // 冒泡法对大小进行排序
    for (i = 0; i < 19 - 1; i++)
    {
        for (j = 0; j < 19 - i - 1; j++)
        {
            if (temp_double[j] < temp_double[j + 1])
            {
                sort_temp = temp_double[j];
                temp_double[j] = temp_double[j + 1];
                temp_double[j + 1] = sort_temp;
            }
        }
    }
    // 寻找最大值序号
    for (i = 0; i < 19; i++)
    {
        if (mag_d[i] == temp_double[0]) // 找到最大数
            frq[0] = i;
        if (mag_d[i] == temp_double[1]) // 找到第二大数
            frq[1] = i;
    }
    if (frq[0] > frq[1])
    { // 把频率低的放在第一个位置，如果颠倒就换一下
        temp_char = frq[0];
        frq[0] = frq[1];
        frq[1] = temp_char;
    }
}

// 计算相位偏移
void Get_Pos_Angle(uint8_t flag)
{
		double  temp_double_sin =0;
		double  temp_double_cos =0;
		double temp_double_angle_0 =0;
		double temp_double_angle_1 = 0;
	
		if(flag == 0)
		{
			temp_double_sin = corr1000_200(adc_complex_value, DAC_SIN + 200 * fre[0]);
			temp_double_cos = corr1000_200(adc_complex_value, DAC_COS + 200 * fre[0]);

			temp_double_angle_0 = atan2(temp_double_cos, temp_double_sin);

			if (temp_double_angle_0 < 0) //atan2函数计算得到的相位差在-pi到pi，但当其小于0时，DAC输出的信号无法提前相位，只能将所有相位全部延迟一个周期，即进行一个周期的求补操作
					pos_angle_0 = -temp_double_angle_0;
			else
					pos_angle_0 = 2 * 3.1415926 - temp_double_angle_0;
		}
		 
		else if(flag == 1)
		{
			temp_double_sin = corr1000_200(adc_complex_value, DAC_SIN + 200 * fre[1]);
			temp_double_cos = corr1000_200(adc_complex_value, DAC_COS + 200 * fre[1]);
			temp_double_angle_1 = atan2(temp_double_cos, temp_double_sin);

			if (temp_double_angle_1 < 0) // atan2函数计算得到的相位差在-pi到pi，但当其小于0时，DAC输出的信号无法提前相位，只能将所有相位全部延迟一个周期，即进行一个周期的求补操作
					pos_angle_1 = -temp_double_angle_1;
			else
					pos_angle_1 = 2 * 3.1415926 - temp_double_angle_1;
		}
    
}

// 提高部分
void FFT_Detect_Type(unsigned char *frq, unsigned char *wave_type) // 根据输入信号及已经判断出来的频率值，通过FFT结果判断信号类型是三角波（1）还是正弦波（0）
// 第一个参数指针指向的数组，其中存放的是之前的其他函数计算出来的两个信号的频率
// 第二个参数指正指向的数组用于存放这两个信号的波形种类，0为正弦，其他值为三角波。需要在本函数中计算产生
{
    short indata[2048], outdata[2048], i;
//    int mag[512],sum = 0, average;
    _Bool conti;

    threshold[0] = (frq[0] < 4) ? 50 : 150;//根据实际频谱计算，低于25KHz受噪声影响较大
		threshold[1] = (frq[1] < 4) ? 50 : 150;


    for (i = 0; i < 1024; i++) // 计算信号平均值
        sum = sum + adc_complex_value[i];
    average = sum / 1024;     //  约等于2048

    for (i = 0; i < 1024; i++)
    {
        indata[2 * i] = adc_complex_value[i] - average; // 减去平均值是为了降低直流分量
        indata[2 * i + 1] = 0;
    }

    cr4_fft_1024_stm32(outdata, indata, 1024); //时域转频域

    for (i = 0; i < 512; i++)                                                               // FFT结果幅度谱是左右对称的，只需要算一半
        mag[i] = outdata[2 * i] * outdata[2 * i] + outdata[2 * i + 1] * outdata[2 * i + 1]; // sqrt(outdata[2*i] * outdata[2*i] + outdata[2*i + 1] * outdata[2*i + 1]);

    //////////计算输入信号频率及其三次谐波频率对应在FFT结果数组中的索引值//////////
    //////初步判断第一个信号的类型//////////////
    temp_float = (float)frq[0] * 5 + 10; // 计算输入索引值所对应的真实频率，单位为KHz
    
    temp_float = temp_float / 500;       // 采样率为1MSPS，则输入频率是奈奎斯特频率的多少倍
    temp_float = temp_float * 512;       // 计算输入信号频率对应的数组索引
    index = temp_float + 0.5f;            // 进行四舍五入取整

    temp_float = (float)frq[0] * 5 + 10; // 计算输入索引值所对应的真实频率，单位为KHz
    temp_float = temp_float / 500;       // 采样率为1MSPS，则输入频率是奈奎斯特频率的多少倍
    temp_float = temp_float * 3 * 512;   // 计算三倍基频对应的数组索引
    harmo3_index = temp_float + 0.5f;     // 进行四舍五入取整

    // 计算一次和三次谐波上的能量及其比值
    mag_1harmo[0] = mag[index - 1] + mag[index] + mag[index + 1];
    mag_3harmo[0] = mag[harmo3_index - 1] + mag[harmo3_index] + mag[harmo3_index + 1];
    k[0] = mag_1harmo[0] / mag_3harmo[0];

    wave_type[0] = (k[0] > threshold[0]) ? 0 : 1;//    1 --- 三角波(小于阈值)，0 --- 正弦波(大于阈值)

    // //////////初步判断第二个信号的类型////////////////
    temp_float = (float)frq[1] * 5 + 10; // 计算输入索引值所对应的真实频率，单位为KHz
    temp_float = temp_float / 500;       // 采样率为1MSPS，则输入频率是奈奎斯特频率的多少倍
    temp_float = temp_float * 512;       // 计算输入信号频率对应的数组索引
    index = temp_float + 0.5f;            // 进行四舍五入取整

    temp_float = (float)frq[1] * 5 + 10; // 计算输入索引值所对应的真实频率，单位为KHz
    temp_float = temp_float / 500;       // 采样率为1MSPS，则输入频率是奈奎斯特频率的多少倍
    temp_float = temp_float * 3 * 512;   // 计算三倍基频对应的数组索引
    harmo3_index = temp_float + 0.5f;     // 进行四舍五入取整

    mag_1harmo[1] = mag[index - 1] + mag[index] + mag[index + 1];
    mag_3harmo[1] = mag[harmo3_index - 1] + mag[harmo3_index] + mag[harmo3_index + 1];
    k[1] = mag_1harmo[1] / mag_3harmo[1];

    wave_type[1] = (k[1] > threshold[1]) ? 0 : 1;

    ////////对第二个信号刚好等于第一个信号三倍频率特殊情况，需要重新判断第一个信号的类型/////
    // 上面的初步判断算有问题的是：第二个信号四第一个信号三倍频率的情况，只有可能包括：
    // 1、第一个信号是10K，第二个信号是30K
    // 2、第一个信号是15K，第二个信号是45K
    // 3、第一个信号是20K，第二个信号是60K
    // 4、第一个信号是25K，第二个信号是75K
    // 5、第一个信号是30K，第二个信号是90K
    conti = ((frq[0] == 0) & (frq[1] == 4)) | 
            ((frq[0] == 1) & (frq[1] == 7)) | 
            ((frq[0] == 2) & (frq[1] == 10)) | 
            ((frq[0] == 3) & (frq[1] == 13)) | 
            ((frq[0] == 4) & (frq[1] == 16));
    if (conti)
    {
        // 计算五次谐波能量和1次谐波能量之比
        temp_float = (float)frq[0] * 5 + 10; // 计算输入索引值所对应的真实频率，单位为KHz
        temp_float = temp_float / 500;       // 采样率为1MSPS，则输入频率是奈奎斯特频率的多少倍
        temp_float = temp_float * 512;       // 计算输入信号频率对应的数组索引
        index = temp_float + 0.5f;            // 进行四舍五入取整
        mag_1harmo[0] = mag[index - 1] + mag[index] + mag[index + 1];

        temp_float = (float)frq[0] * 5 + 10; // 计算输入索引值所对应的真实频率，单位为KHz
        temp_float = temp_float / 500;       // 采样率为1MSPS，则输入频率是奈奎斯特频率的多少倍
        temp_float = temp_float * 5 * 512;   // 计算5倍基频对应的数组索引
        harmo5_index = temp_float + 0.5f;     // 进行四舍五入取整
        mag_5harmo = mag[harmo5_index - 1] + mag[harmo5_index] + mag[harmo5_index + 1];
        k[0] = mag_1harmo[0] / mag_5harmo;
        if (k[0] > 70)
            wave_type[0] = 0; // 5次谐波较小，说明是正弦波
        else
            wave_type[0] = 1; // 5次谐波较大，说明是三角波
    }
}
